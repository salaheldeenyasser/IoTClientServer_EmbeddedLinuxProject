## CommApp/CommAppYocto/yocto/poky/conf/bblayers.conf
```bitbake
POKY_BBLAYERS_CONF_VERSION = "2"

BBPATH = "${TOPDIR}"
BBFILES ?= ""

BBLAYERS ?= " \
  /home/seyho/yocto/poky/meta \
  /home/seyho/yocto/poky/meta-poky \
  /home/seyho/yocto/poky/meta-yocto-bsp \
  /home/seyho/yocto/meta-raspberrypi \
  /home/seyho/yocto/poky/meta-myLayer \
  "
```

## CommApp/CommAppYocto/yocto/poky/meta-myLayer/conf/layer.conf
```bitbake
BBPATH .= ":${LAYERDIR}"
BBFILES += "${LAYERDIR}/recipes-*/*/*.bb"
BBFILES += "${LAYERDIR}/recipes-*/*/*.bbappend"
BBFILES += "${LAYERDIR}/recipes-*/*.bbappend"
BBFILE_COLLECTIONS += "myLayer"
BBFILE_PATTERN_myLayer = "^${LAYERDIR}/"
BBFILE_PRIORITY_myLayer = "10"
LAYERSERIES_COMPAT_myLayer = "kirkstone scarthgap"
LAYERDEPENDS_myLayer = "core"
```
